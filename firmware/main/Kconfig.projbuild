## firmware/main/Kconfig.projbuild
```kconfig
menu "Example Configuration"
    config LV_MEM_SIZE_KILOBYTES
        int "Size of the memory used by `lv_mem_alloc` in kilobytes (>= 2kB)"
        default 48

        
    

endmenu
```
